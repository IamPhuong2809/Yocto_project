## conf/bblayers.conf
```bitbake
# POKY_BBLAYERS_CONF_VERSION is increased each time build/conf/bblayers.conf
# changes incompatibly
POKY_BBLAYERS_CONF_VERSION = "2"

BBPATH = "${TOPDIR}"
BBFILES ?= ""

BBLAYERS ?= " \
  /home/phuongnguyen/Yocto/poky/meta \
  /home/phuongnguyen/Yocto/poky/meta-poky \
  /home/phuongnguyen/Yocto/poky/meta-yocto-bsp \
  /home/phuongnguyen/Yocto/meta-openembedded/meta-oe \
  /home/phuongnguyen/Yocto/meta-openembedded/meta-python \
  /home/phuongnguyen/Yocto/meta-openembedded/meta-networking \
  /home/phuongnguyen/Yocto/meta-raspberrypi \ 
  "
```
